#ifndef CASINO_OLED_TEXT_H
#define CASINO_OLED_TEXT_H
#include <Arduino.h>

// 16x2-Textanzeige auf einem 128x64-OLED (1,3 Zoll SH1106 oder 0,96 Zoll SSD1306).
// Bietet die Aufrufe, die der Sketch vom alten HD44780-LCD kannte: setCursor(),
// print() und write(). Dazu eine kleine Hinweiszeile ganz unten.
//
// Bewusst ohne U8g2 und ohne Wire: das spart rund 5 KB Flash und 280 Byte
// RAM, und es muss keine Bibliothek installiert werden. Die I2C-Hardware (TWI, SDA = A4, SCL = A5) wird direkt ueber
// ihre Register bedient, das Display im Seitenmodus, den SH1106 und SSD1306
// gleich verstehen. Kein Bildspeicher im RAM: gemerkt werden nur die 32
// sichtbaren Zeichen, damit unveraenderte Stellen nicht neu uebertragen werden.
//
// Aufteilung der 8 Kachelzeilen: 0 Titelbalken, 2-3 Zeile 0, 4-5 Zeile 1,
// 7 Hinweis. Zeichen in den Textzeilen sind 8x16 Pixel (doppelt hoch).
// Sonderzeichen wie beim HD44780: 0 = Euro, 255 = voller Block.

#ifndef CASINO_OLED_SSD1306
#define CASINO_OLED_SSD1306 0
#endif
// Der SH1106 hat 132 Spalten, sichtbar sind die mittleren 128.
const uint8_t OLED_SPALTE0 = (CASINO_OLED_SSD1306 || CASINO_SIM) ? 0 : 2;
const uint8_t OLED_ADRESSE = 0x3C << 1;

// Grundeinstellung wie bei U8g2 (ssd1306_128x64_noname), Seitenmodus.
static const uint8_t OLED_INIT[] PROGMEM = {
  0xAE, 0xD5, 0x80, 0xA8, 0x3F, 0xD3, 0x00, 0x40, 0x8D, 0x14, 0x20, 0x02,
  0xA1, 0xC8, 0xDA, 0x12, 0x81, 0xCF, 0xD9, 0xF1, 0xDB, 0x40, 0x2E, 0xA4,
  0xA6, 0xAF
};
// Schrift "Chroma48 medium 8" aus U8g2 (u8x8_font_chroma48medium8_r),
// lizenziert unter CC0 (gemeinfrei). Zeichen 32 bis 126, je 8 Spalten,
// Bit 0 ist die oberste Pixelzeile.
static const uint8_t OLED_SCHRIFT[95 * 8] PROGMEM = {
  0x00, 0x00, 0x00, 0x00, 0x00, 0x00, 0x00, 0x00,  // Leerzeichen
  0x00, 0x00, 0x00, 0x5E, 0x00, 0x00, 0x00, 0x00,  // !
  0x00, 0x00, 0x06, 0x00, 0x00, 0x06, 0x00, 0x00,  // "
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  0x08, 0x04, 0x04, 0x08, 0x10, 0x10, 0x08, 0x00,  // ~
};
// Euro, 8x8 Punkte, Bit 7 ist die linke Spalte. Wird doppelt hoch gezeichnet.
static const uint8_t OLED_EURO[8] PROGMEM = {
  0x1C, 0x20, 0x78, 0x20, 0x78, 0x20, 0x1C, 0x00
};

class OledText : public Print {
public:
  void begin() {
    delay(50);                  // Display nach dem Einschalten hochkommen lassen.
    PORTC |= _BV(4) | _BV(5);   // Interne Pullups zusaetzlich zu denen am Modul.
    TWSR = 0;
    TWBR = 12;                  // 400 kHz bei 16 MHz.
    befehle(OLED_INIT, sizeof(OLED_INIT));
    for (uint8_t seite = 0; seite < 8; ++seite) {   // Alles loeschen, 132 Spalten.
      position(seite, 0, 0);
      daten();
      for (uint8_t i = 0; i < 132; ++i) twiByte(0);
      twiStop();
    }
    const char *titel = "  MINI  CASINO  ";
    for (uint8_t x = 0; x < 16; ++x) zeichen1(x, 0, (uint8_t)titel[x], true);
    memset(zeichen, ' ', sizeof(zeichen));
    spalte = zeile = 0;
    hinweisSoll = hinweisIst = nullptr;
  }

  // Hinweiszeile nur vormerken; gezeichnet wird sie in hinweisAktualisieren()
  // aus loop(). So flackert nichts, wenn ein Bildschirm erst leert und dann
  // gleich wieder denselben Hinweis setzt. nullptr = leere Zeile.
  void hinweis(const __FlashStringHelper *text) { hinweisSoll = text; }
  void hinweisAktualisieren() {
    if (hinweisSoll == hinweisIst) return;
    hinweisIst = hinweisSoll;
    PGM_P p = (PGM_P)hinweisIst;
    bool ende = !p;
    for (uint8_t x = 0; x < 16; ++x) {
      char c = ende ? ' ' : (char)pgm_read_byte(p + x);
      if (!c) { ende = true; c = ' '; }
      zeichen1(x, 7, (uint8_t)c, false);
    }
  }

  void setCursor(uint8_t neueSpalte, uint8_t neueZeile) {
    spalte = neueSpalte;
    zeile = neueZeile ? 1 : 0;
  }

  size_t write(uint8_t c) override {
    if (spalte >= 16) return 1;   // Rechts abschneiden statt umbrechen.
    if (zeichen[zeile][spalte] != c) {
      zeichen[zeile][spalte] = c;
      zeichen2(spalte, zeile ? 4 : 2, c);
    }
    ++spalte;
    return 1;
  }
  using Print::write;

private:
  char zeichen[2][16];
  uint8_t spalte = 0, zeile = 0;
  const __FlashStringHelper *hinweisSoll = nullptr, *hinweisIst = nullptr;

  // --- I2C von Hand: Start, Bytes, Stop. Bleibt eine Antwort aus, laeuft es
  // trotzdem weiter, das Display bleibt dann nur dunkel.
  static void twiWarten() { while (!(TWCR & _BV(TWINT))) {} }
  static void twiByte(uint8_t b) { TWDR = b; TWCR = _BV(TWINT) | _BV(TWEN); twiWarten(); }
  static void twiStart(uint8_t steuer) {
    TWCR = _BV(TWINT) | _BV(TWSTA) | _BV(TWEN);
    twiWarten();
    twiByte(OLED_ADRESSE);
    twiByte(steuer);   // 0x00 = Befehle folgen, 0x40 = Bilddaten folgen.
  }
  static void twiStop() {
    TWCR = _BV(TWINT) | _BV(TWSTO) | _BV(TWEN);
    while (TWCR & _BV(TWSTO)) {}
  }
  static void befehle(const uint8_t *liste, uint8_t anzahl) {
    twiStart(0x00);
    for (uint8_t i = 0; i < anzahl; ++i) twiByte(pgm_read_byte(liste + i));
    twiStop();
  }
  static void daten() { twiStart(0x40); }
  // Seite (Kachelzeile 0..7) und Pixelspalte setzen.
  static void position(uint8_t seite, uint8_t x, uint8_t versatz) {
    uint8_t s = (uint8_t)(x + versatz);
    twiStart(0x00);
    twiByte((uint8_t)(0xB0 | seite));
    twiByte((uint8_t)(s & 0x0F));
    twiByte((uint8_t)(0x10 | (s >> 4)));
    twiStop();
  }

  // Spalten eines Zeichens, Bit 0 ist die oberste Pixelzeile.
  static uint8_t spalteVon(uint8_t c, uint8_t sp) {
    if (c == 255) return 0xFF;
    if (c == 0) {
      uint8_t bits = 0;
      for (uint8_t r = 0; r < 8; ++r)
        if (pgm_read_byte(OLED_EURO + r) & (0x80 >> sp)) bits |= (uint8_t)(1 << r);
      return bits;
    }
    if (c < 32 || c > 126) c = '?';   // Die Schrift kennt nur ASCII.
    return pgm_read_byte(OLED_SCHRIFT + (c - 32) * 8 + sp);
  }
  // Vier Bits auf acht strecken: jede Pixelzeile wird doppelt so hoch.
  static uint8_t strecke(uint8_t vier) {
    uint8_t acht = 0;
    for (uint8_t i = 0; i < 4; ++i)
      if (vier & (1 << i)) acht |= (uint8_t)(3 << (2 * i));
    return acht;
  }
  static void zeichen1(uint8_t x, uint8_t seite, uint8_t c, bool invers) {
    position(seite, (uint8_t)(x * 8), OLED_SPALTE0);
    daten();
    for (uint8_t sp = 0; sp < 8; ++sp) {
      uint8_t b = spalteVon(c, sp);
      twiByte(invers ? (uint8_t)~b : b);
    }
    twiStop();
  }
  static void zeichen2(uint8_t x, uint8_t seite, uint8_t c) {
    for (uint8_t haelfte = 0; haelfte < 2; ++haelfte) {
      position((uint8_t)(seite + haelfte), (uint8_t)(x * 8), OLED_SPALTE0);
      daten();
      for (uint8_t sp = 0; sp < 8; ++sp) {
        uint8_t b = spalteVon(c, sp);
        twiByte(strecke(haelfte ? (uint8_t)(b >> 4) : (uint8_t)(b & 0x0F)));
      }
      twiStop();
    }
  }
};
#endif
